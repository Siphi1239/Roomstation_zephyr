## west.yml
```yaml
manifest: 
  version: "1.2"
      
  projects:
    - name: zephyr
      url: https://github.com/zephyrproject-rtos/zephyr.git
      revision: v3.7.0
      clone-depth: 5
      import:
        path-prefix: deps
    - name: boards
      url: https://github.com/siphi1239/zephyr_boards.git
      revision: main

self: 
  path: app
```
